## config/boards/shields/keaboard/Kconfig.defconfig
```kconfig
if SHIELD_KEABOARD_LEFT

config ZMK_KEYBOARD_NAME
    default "Keaboard"

config ZMK_SPLIT_ROLE_CENTRAL
    default y

endif

if SHIELD_KEABOARD_LEFT || SHIELD_KEABOARD_RIGHT

config ZMK_SPLIT
    default y

endif
```

## config/boards/shields/keaboard/Kconfig.shield
```kconfig
config SHIELD_KEABOARD_LEFT
    def_bool $(shields_list_contains,keaboard_left)

config SHIELD_KEABOARD_RIGHT
    def_bool $(shields_list_contains,keaboard_right)
```
